## sdkconfig.defaults
```kconfig
# ESP32-P4 SD Card Configuration with exFAT support

# Flash configuration (32MB)
CONFIG_ESPTOOLPY_FLASHSIZE_32MB=y
CONFIG_ESPTOOLPY_FLASHSIZE="32MB"
CONFIG_ESPTOOLPY_FLASHMODE_QIO=y
CONFIG_ESPTOOLPY_FLASHFREQ_80M=y
CONFIG_BOOTLOADER_CACHE_32BIT_ADDR_FLASH=y
CONFIG_BOOTLOADER_CACHE_32BIT_ADDR_QUAD_FLASH=y
CONFIG_BOOTLOADER_CACHE_32BIT_ADDR_OCTAL_FLASH=y

# Partition table
CONFIG_PARTITION_TABLE_CUSTOM=y
CONFIG_PARTITION_TABLE_CUSTOM_FILENAME="partitions.csv"

# Enable exFAT filesystem support
CONFIG_FATFS_LFN_HEAP=y
CONFIG_FATFS_MAX_LFN=255
CONFIG_FATFS_USE_LABEL=y

# SDMMC configuration
CONFIG_SOC_SDMMC_HOST_SUPPORTED=y

# Console/UART
CONFIG_ESP_CONSOLE_UART_DEFAULT=y
CONFIG_ESP_CONSOLE_UART_BAUDRATE=115200

# PSRAM
CONFIG_SPIRAM=y
CONFIG_SPIRAM_MODE_OCT=y
CONFIG_SPIRAM_SPEED_200M=y

# HTTPS Server Support (required for PsychicHttpsServer)
CONFIG_HTTPD_WS_SUPPORT=y
CONFIG_ESP_HTTPS_SERVER_ENABLE=y

# Increase HTTP request body size limit for file uploads and canvas pixel data
# Canvas: 800x600 pixels = 480KB raw, ~640KB base64-encoded
# For larger files, chunked uploads are used (splits into 400KB chunks)
# PsychicHttp uses ESP-IDF httpd which has a default max body size limit
# Increase max URI length and header length to allow larger requests
CONFIG_HTTPD_MAX_REQ_HDR_LEN=4096
CONFIG_HTTPD_MAX_URI_LEN=2048
CONFIG_HTTPD_MAX_REQ_BODY_LEN=1048576

# Increase HTTP server task stack size to handle large file uploads
# Default is 4096 bytes, increase to 16KB to prevent stack overflow
CONFIG_HTTPD_TASK_STACK_SIZE=16384
```
